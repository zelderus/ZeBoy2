


;#################################################
;##############    DATA   ########################
;#################################################



; game over text
DDD_DATA_GMO	EQU 0x13A0
ORG 0x13A0
	DB 0x7E, 0x7E, 0x02, 0x02, 0x7E, 0x7E, 0x00
	DB 0x7E, 0x7E, 0x42, 0x42, 0x7E, 0x7E, 0x00	
	DB 0x02, 0x02, 0x7E, 0x7E, 0x02, 0x02, 0x00	
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	DB 0x7E, 0x7E, 0x42, 0x42, 0x7E, 0x7E, 0x00	
	
;; man 
DDD_DATA_MAN_RUN	EQU 0x13F0
ORG 0x13F0
	DB 0x00, 0x44, 0x4A, 0x3E, 0x0F, 0x1E, 0x24, 0xC0
	DB 0x00, 0x20, 0x3E, 0xEF, 0x3E, 0x04, 0x02, 0x00
	
DDL_MAN_FRAMES		EQU 0x18	; 24 кадра на анимацию прыжка (собственно и длина прыжка)
DDD_DATA_MAN_DOWN	EQU 0x1400	; нижняя часть по кадрам	(нижний DPL адрес должен быть ближе к 0, чтобы проще складывать адрес в 8 битке)
ORG 0x1400
	DB 0x00, 0x04, 0xC2, 0x3C, 0x1F, 0x3C, 0xC2, 0x04
	DB 0x00, 0x42, 0x22, 0x1E, 0x0F, 0x1E, 0x22, 0x42
	DB 0x00, 0x04, 0x02, 0x02, 0x01, 0x01, 0x02, 0x04
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	DB 0x00, 0x04, 0xC2, 0x3C, 0x1F, 0x3C, 0xC2, 0x04

DDD_DATA_MAN_UP	EQU 0x1500		; верхняя часть по кадрам (нижний DPL адрес должен быть ближе к 0, чтобы проще складывать адрес в 8 битке)
ORG 0x1500
	DB 0x00, 0x00, 0x00, 0x00, 0x00, 0x00, 0x00, 0x00
	DB 0x00, 0x00, 0x00, 0x00, 0x80, 0x00, 0x00, 0x00
	DB 0x00, 0x20, 0x20, 0xE0, 0xF8, 0xE0, 0x20, 0x20
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	DB 0x00, 0x00, 0x00, 0x00, 0x00, 0x00, 0x00, 0x00

;; obstacles
; тут стоит переделать, чтобы хранить ID на объекты, увеличив длину уровня в рамках байта (для скролла)
; либо оставить так, если очень важна скорость (итак нету видео буфера в этой версии)
DDL_OBST_ROWS	EQU 0xF0
DDD_DATA_OBST	EQU 0x1675	; у каждого препятствия должен быть 8 бит всегда установлен на протяжении всего препятствия
ORG 0x1675
	DB 0x00, 0x00, 0x00, 0x00, 0x00, 0x00, 0x00, 0x00, 0x00, 0x00
	DB 0x00, 0x00, 0x00, 0x00, 0x00, 0x00, 0x00, 0x00, 0x00, 0x00
	DB 0x00, 0x00, 0x00, 0x00, 0x00, 0x00, 0x00, 0x00, 0x00, 0x00
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	DB 0x00, 0x00, 0x98, 0x88, 0x88, 0xFC, 0xFC, 0x88, 0x88, 0x98
	
	; repeat first (для упрощения расчетов)
	DB 0x00, 0x00, 0x00, 0x00, 0x00, 0x00, 0x00, 0x00, 0x00, 0x00
	DB 0x00, 0x00, 0x00, 0x00, 0x00, 0x00, 0x00, 0x00, 0x00, 0x00
	DB 0x00, 0x00, 0x00, 0x00, 0x00, 0x00, 0x00, 0x00, 0x00, 0x00
	DB 0x00, 0x00, 0x00, 0x00, 0x00, 0x00, 0x00, 0x00, 0x00, 0x00
	DB 0x00, 0x00, 0x00, 0x00, 0x00, 0x00, 0x00, 0x00, 0x00, 0x00
	DB 0xF8, 0xF8, 0xFC, 0xFF, 0xFF, 0xFC, 0xF8, 0xF8, 0x00, 0x00
	
;; air
DDD_DATA_AIR	EQU 0x17A1
ORG 0x17A1
	DB 0x08, 0x1C, 0x36, 0x22, 0x20, 0x20, 0x38, 0x0C
	DB 0x04, 0x0E, 0x1A, 0x12, 0x10, 0x18, 0x08, 0x08
;; ground
DDD_DATA_GROUND	EQU 0x17B1
ORG 0x17B1
	DB 0xCF, 0xC9, 0xF9, 0xC9, 0xCF, 0xC9, 0xF9, 0xC9
	DB 0xCF, 0xC9, 0xF9, 0xC9, 0xCF, 0xC9, 0xF9, 0xC9
;; table border (static)
DDD_DATA_TBLB	EQU 0x17C1
ORG 0x17C1
	DB 0xFF, 0xFF, 0x55, 0xAA, 0x55, 0xAA, 0x55, 0xAA, 0x55, 0xAA
	DB 0x55, 0xAA, 0x55, 0xAA, 0x55, 0xAA, 0x55, 0xAA, 0x55, 0xAA
	DB 0x55, 0xAA, 0x55, 0xAA, 0x55, 0xAA, 0x55, 0xAA, 0x55, 0xAA
	DB 0x55, 0xAA, 0x55, 0xAA, 0x55, 0xAA, 0x55, 0xAA, 0x55, 0xAA
	DB 0x55, 0xAA, 0x55, 0xAA, 0x55, 0xAA, 0x55, 0xAA, 0x55, 0xAA
	DB 0x55, 0xAA, 0x55, 0xAA, 0x55, 0xAA, 0x55, 0xAA, 0x55, 0xFF
	DB 0xFF

; last byte	
DATABR:
	DB 0x40
